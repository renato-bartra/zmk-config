## dts/bindings/behaviors/lily58pro,behavior-display-toggle.yaml
```yaml
# Copyright (c) 2024 The ZMK Contributors
# SPDX-License-Identifier: MIT

description: Lily58 Pro Display Toggle Behavior

compatible: "lily58pro,behavior-display-toggle"

include: zero_param.yaml
```

## src/Kconfig.zmk
```kconfig
# Lily58 Pro display toggle custom behavior

config LILY58PRO_DISPLAY_TOGGLE
    bool "Lily58 Pro display toggle behavior"
    default y
    help
      Enables a custom &display_toggle behavior for the Lily58 Pro
      that turns the OLED status screen on/off via the both-spaces
      combo defined in lily58.keymap.

if LILY58PRO_DISPLAY_TOGGLE

config LILY58PRO_DISPLAY_TOGGLE_DEV_NAME
    string "Display device name (used to look up the display)"
    default ""
    help
      Optional: explicit display device name. When empty, the
      behavior uses DEVICE_DT_GET(DT_CHOSEN(zephyr_display)).

endif # LILY58PRO_DISPLAY_TOGGLE
```
